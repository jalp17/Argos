## sdkconfig.defaults
```kconfig
# Argos - Configuración por defecto del SDK
# Framework de Instrumentación Modular para ESP32

# ==================== Watchdogs ====================
CONFIG_ESP_TASK_WDT_EN=y
CONFIG_ESP_TASK_WDT_TIMEOUT_S=10
CONFIG_ESP_TASK_WDT_PANIC=y
CONFIG_ESP_TASK_WDT_CHECK_IDLE_TASK_CPU0=y
CONFIG_ESP_TASK_WDT_CHECK_IDLE_TASK_CPU1=y

CONFIG_ESP_INT_WDT=y
CONFIG_ESP_INT_WDT_TIMEOUT_MS=300

# ==================== Heap ====================
CONFIG_HEAP_POISONING_DISABLED=y
CONFIG_HEAP_TRACING_OFF=y
CONFIG_LOG_DEFAULT_LEVEL_INFO=y

# ==================== WiFi ====================
CONFIG_ESP_WIFI_SOFTAP_SUPPORT=y
CONFIG_ESP_WIFI_STATIC_RX_BUFFER_NUM=10
CONFIG_ESP_WIFI_DYNAMIC_RX_BUFFER_NUM=32
CONFIG_ESP_WIFI_DYNAMIC_TX_BUFFER_NUM=32
CONFIG_ESP_WIFI_TX_BUFFER_TYPE=1

# ==================== HTTP Server ====================
CONFIG_HTTPD_WS_SUPPORT=y
CONFIG_HTTPD_MAX_REQ_HDR_LEN=512
CONFIG_HTTPD_MAX_URI_LEN=256

# ==================== FreeRTOS ====================
CONFIG_FREERTOS_HZ=1000
CONFIG_FREERTOS_QUEUE_REGISTRY_SIZE=10
CONFIG_FREERTOS_TASK_NOTIFICATION_ARRAY_ENTRIES=1

# ==================== LittleFS ====================
CONFIG_LITTLEFS_MAX_PARTITIONS=3
CONFIG_LITTLEFS_SPIFFS_COMPAT=y

# ==================== Compiler Optimizations ====================
CONFIG_OPTIMIZATION_LEVEL_RELEASE=y
CONFIG_COMPILER_OPTIMIZATION_SIZE=y

# ==================== Logging ====================
CONFIG_LOG_DEFAULT_LEVEL=3
CONFIG_LOG_TIMESTAMP_SOURCE_RTOS=y
```
